## config/boards/shields/left_artsey/Kconfig.shield
```kconfig
# No whitespace after the comma or in your keyboard name!
config SHIELD_LEFTARTSEY
    def_bool $(shields_list_contains,left_artsey)
```

## config/boards/shields/wrist_artesy/Kconfig.defconfig
```kconfig
if SHIELD_WRISTARTESY

config ZMK_KEYBOARD_NAME
    default "Wrist Artesy"

endif
```
