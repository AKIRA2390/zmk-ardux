/*
 * Copyright (c) 2021 Dennis "depadiernos" Padiernos
 *
 * SPDX-License-Identifier: MIT
 */

#include <behaviors.dtsi>
#include <dt-bindings/zmk/keys.h>
#include <dt-bindings/zmk/bt.h>

// Left/Right
#define ARDUX_RIGHT 1

// ARTS Row
#define KEY_A <&xiao_d 3>
#define KEY_R <&xiao_d 4>
#define KEY_T <&xiao_d 5>
#define KEY_S <&xiao_d 6>
// EYIO Row
#define KEY_E <&xiao_d 10>
#define KEY_Y <&xiao_d 9>
#define KEY_I <&xiao_d 8>
#define KEY_O <&xiao_d 7>

// Define Offsets
#define LEADING_NONES NONE(0,0,0)
#define MIDDLE_NONES NONE(0, 0, 0)
#define TRAILING_NONES NONE(0, 0, 0)

// Include main ardux.io keymap
#include "../../../ardux.dtsi"
